## robot-embedded-firmware/sdkconfig.defaults
```kconfig
CONFIG_ESP_WIFI_SSID="ROBOT"
CONFIG_ESP_WIFI_PASSWORD="88888888"

CONFIG_FREERTOS_HZ=1000

#CONFIG_LOG_DEFAULT_LEVEL_DEBUG=n
CONFIG_LOG_DEFAULT_LEVEL_INFO=y
CONFIG_LOG_MAXIMUM_LEVEL_VERBOSE=y
CONFIG_LOG_DEFAULT_LEVEL=3
CONFIG_LOG_MAXIMUM_LEVEL=5
CONFIG_ESPP_I2C_LEGACY_API_DISABLE_DEPRECATION_WARNINGS=y

CONFIG_PARTITION_TABLE_CUSTOM=y
CONFIG_PARTITION_TABLE_CUSTOM_FILENAME="partitions.csv"

CONFIG_ESPTOOLPY_FLASHSIZE_4MB=y
CONFIG_ESPTOOLPY_FLASHSIZE="4MB"


#
# BT config
#
CONFIG_BT_ENABLED=y
CONFIG_BTDM_CTRL_MODE_BLE_ONLY=y
CONFIG_BTDM_CTRL_MODE_BR_EDR_ONLY=n
CONFIG_BTDM_CTRL_MODE_BTDM=n
CONFIG_BT_BLUEDROID_ENABLED=n
CONFIG_BT_NIMBLE_ENABLED=y

CONFIG_BLINK_LED_GPIO=y
CONFIG_BLINK_GPIO=8
```

## sdkconfig.defaults
```kconfig
CONFIG_ESP_WIFI_SSID="ROBOT"
CONFIG_ESP_WIFI_PASSWORD="88888888"

CONFIG_FREERTOS_HZ=1000

CONFIG_LOG_DEFAULT_LEVEL_DEBUG=y
CONFIG_LOG_MAXIMUM_LEVEL_VERBOSE=y
CONFIG_LOG_DEFAULT_LEVEL=4
CONFIG_LOG_MAXIMUM_LEVEL=5
CONFIG_ESPP_I2C_LEGACY_API_DISABLE_DEPRECATION_WARNINGS=y

CONFIG_PARTITION_TABLE_CUSTOM=y
CONFIG_PARTITION_TABLE_CUSTOM_FILENAME="partitions.csv"

CONFIG_ESPTOOLPY_FLASHSIZE_4MB=y
CONFIG_ESPTOOLPY_FLASHSIZE="4MB"
```
